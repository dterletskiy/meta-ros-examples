## conf/layer.conf
```bitbake
# We have a conf and classes directory, add to BBPATH
BBPATH .= ":${LAYERDIR}"

# We have recipes-* directories, add to BBFILES
BBFILES += "${LAYERDIR}/recipes-*/*/*.bb \
            ${LAYERDIR}/recipes-*/*/*.bbappend"

BBFILE_COLLECTIONS += "meta-ros-examples"
BBFILE_PATTERN_meta-ros-examples = "^${LAYERDIR}/"
BBFILE_PRIORITY_meta-ros-examples = "6"

LAYERDEPENDS_meta-ros-examples = "core"
LAYERSERIES_COMPAT_meta-ros-examples = "${ROS_OE_RELEASE_SERIES}"
```
